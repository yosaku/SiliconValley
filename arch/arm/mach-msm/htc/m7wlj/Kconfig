## arch/arm/mach-msm/htc/m7wlj/Kconfig
```kconfig
config BOARD_HEADER_FILE
	string "HTC board specific header file name"
	default ""

config MACH_M7_WLJ
#       depends on ARCH_APQ8064
        bool "HTC J One"
        select MACH_HTC
        help
          Support for the HTC APQ8064 M7_WLJ.

config CABC_DIMMING_SWITCH
	depends on MACH_M7_WLJ
	bool "Enable panel CABC dimming switch"
	default y
	help
	  Enable CABC dimming switch.

config SRE_CONTROL
	depends on MACH_M7_WLJ
	bool "Enable panel SRE control"
	default y
	help
	  Enable SRE control.
```
